## platforms/esp32/main/Kconfig.projbuild
```kconfig
menu "MoL Keyboard audio host"

    config MOL_QEMU_RUNTIME
        bool "Run the bounded Espressif QEMU firmware smoke test"
        default n
        help
            Replaces physical I2S pacing with a deterministic virtual sink and skips
            radio, USB, and GPIO startup so the real ESP-IDF image can execute on
            Espressif QEMU. This option is for emulator evidence only and must never
            be enabled in a board release image.

    config MOL_INPUT_QUEUE_LENGTH
        int "Bounded cross-task input command queue length"
        range 32 128
        default 64

    config MOL_DEVICE_CONTROL_QUEUE_LENGTH
        int "Bounded configuration settings queue length"
        range 2 16
        default 4

    config MOL_DEVICE_CONTROL_TASK_PRIORITY
        int "Configuration and persistence task priority"
        range 1 10
        default 3

    config MOL_DEVICE_CONTROL_TASK_CORE
        int "Configuration and persistence task core affinity"
        range 0 1
        default 0

    config MOL_DEVICE_CONTROL_TASK_STACK_SIZE
        int "Static configuration and persistence task stack size"
        range 3072 8192
        default 4096

    config MOL_DEVICE_WEB_UI_ENABLE
        bool "Build the physically authorized local Web configuration service"
        default n
        help
            Builds an AP-only HTTP configuration service. It remains stopped until the
            designated physical configuration gesture is held and shuts down on timeout.

    if MOL_DEVICE_WEB_UI_ENABLE

    config MOL_DEVICE_WEB_SESSION_SECONDS
        int "Physical configuration authorization window in seconds"
        range 60 3600
        default 600

    config MOL_DEVICE_WEB_AP_CHANNEL
        int "Private configuration access point channel"
        range 1 13
        default 6

    config MOL_DEVICE_WEB_MAX_CLIENTS
        int "Maximum concurrent configuration clients"

        range 1 2
        default 1

    config MOL_DEVICE_WEB_TASK_PRIORITY
        int "HTTP configuration task priority"
        range 1 10
        default 2

    config MOL_DEVICE_WEB_TASK_CORE
        int "HTTP configuration task core affinity"
        range 0 1
        default 0

    config MOL_DEVICE_WEB_TASK_STACK_SIZE
        int "HTTP configuration task stack size"
        range 4096 8192
        default 6144

    endif

    config MOL_BLUETOOTH_HID_TASK_PRIORITY
        int "Bluetooth HID reconnect task priority"
        range 1 10
        default 5

    config MOL_BLUETOOTH_HID_TASK_CORE
        int "Bluetooth HID reconnect task core affinity"
        range 0 1
        default 0

    config MOL_BLUETOOTH_HID_TASK_STACK_SIZE
        int "Static Bluetooth HID reconnect task stack size"
        range 3072 8192
        default 4096

    config MOL_BLUETOOTH_HID_EVENT_STACK_SIZE
        int "ESP HID event task stack size"
        range 3072 8192
        default 4096

    config MOL_A2DP_ENABLE
        bool "Enable original ESP32 A2DP Source output"
        depends on IDF_TARGET_ESP32 && BT_A2DP_ENABLE && !MOL_QEMU_RUNTIME
        default y

    if MOL_A2DP_ENABLE

    config MOL_A2DP_PCM_BUFFER_BYTES
        int "Static A2DP PCM16 stereo stream buffer bytes"
        range 4096 16384
        default 8192
        help
            Must be a multiple of four. The audio task never waits when this buffer is full.

    config MOL_A2DP_CONTROL_TASK_PRIORITY
        int "A2DP connection and media-control task priority"
        range 1 10
        default 4

    config MOL_A2DP_CONTROL_TASK_CORE
        int "A2DP control task core affinity"
        range 0 1
        default 0

    config MOL_A2DP_CONTROL_TASK_STACK_SIZE
        int "Static A2DP control task stack size"
        range 2048 8192
        default 3072

    endif

    config MOL_USB_HID_ENABLE
        bool "Enable the ESP32-S3 USB HID keyboard host"
        depends on IDF_TARGET_ESP32S3 && !MOL_QEMU_RUNTIME
        default y

    if MOL_USB_HID_ENABLE

    config MOL_USB_HID_TASK_PRIORITY
        int "USB HID class event task priority"
        range 1 10
        default 5

    config MOL_USB_HID_TASK_CORE
        int "USB HID task core affinity"
        range 0 1
        default 0

    config MOL_USB_HID_TASK_STACK_SIZE
        int "Static USB HID class event task stack size"
        range 3072 8192
        default 4096

    config MOL_USB_HOST_TASK_PRIORITY
        int "USB Host library event task priority"
        range 1 10
        default 4

    config MOL_USB_HOST_TASK_STACK_SIZE
        int "Static USB Host library event task stack size"
        range 3072 8192
        default 4096

    endif

    config MOL_I2S_SAMPLE_RATE
        int "I2S sample rate"
        range 16000 48000
        default 32000

    config MOL_I2S_BCLK_GPIO
        int "I2S bit-clock GPIO"
        range 0 48
        default 26 if IDF_TARGET_ESP32
        default 4 if IDF_TARGET_ESP32S3

    config MOL_I2S_WS_GPIO
        int "I2S word-select GPIO"
        range 0 48
        default 25 if IDF_TARGET_ESP32
        default 5 if IDF_TARGET_ESP32S3

    config MOL_I2S_DOUT_GPIO
        int "I2S serial-data output GPIO"
        range 0 48
        default 22 if IDF_TARGET_ESP32
        default 6 if IDF_TARGET_ESP32S3

    config MOL_I2S_MCLK_GPIO
        int "Optional I2S master-clock GPIO (-1 disables MCLK)"
        range -1 48
        default -1

    config MOL_I2S_DMA_DESCRIPTOR_COUNT
        int "Fixed I2S DMA descriptor count"
        range 2 16
        default 6

    config MOL_I2S_ENABLE_DITHER
        bool "Enable deterministic triangular PCM16 dither"
        default n

    config MOL_AUDIO_TASK_PRIORITY
        int "Audio render task priority"
        range 1 24
        default 20

    config MOL_AUDIO_TASK_CORE
        int "Audio render task core affinity"
        range 0 1
        default 1

    config MOL_AUDIO_TASK_STACK_SIZE
        int "Static audio task stack size in bytes"
        range 3072 16384
        default 4096

    config MOL_GPIO_MATRIX_ENABLE
        bool "Enable the reference 5x6 GPIO keyboard matrix"
        depends on !MOL_QEMU_RUNTIME
        default y

    if MOL_GPIO_MATRIX_ENABLE

    config MOL_GPIO_ROW0
        int "Matrix row 0 GPIO"
        range 0 48
        default 13 if IDF_TARGET_ESP32
        default 7 if IDF_TARGET_ESP32S3

    config MOL_GPIO_ROW1
        int "Matrix row 1 GPIO"
        range 0 48
        default 14 if IDF_TARGET_ESP32
        default 8 if IDF_TARGET_ESP32S3

    config MOL_GPIO_ROW2
        int "Matrix row 2 GPIO"
        range 0 48
        default 16 if IDF_TARGET_ESP32
        default 9 if IDF_TARGET_ESP32S3

    config MOL_GPIO_ROW3
        int "Matrix row 3 GPIO"
        range 0 48
        default 17 if IDF_TARGET_ESP32
        default 10 if IDF_TARGET_ESP32S3

    config MOL_GPIO_ROW4
        int "Matrix row 4 GPIO"
        range 0 48
        default 18 if IDF_TARGET_ESP32
        default 11 if IDF_TARGET_ESP32S3

    config MOL_GPIO_COLUMN0
        int "Matrix column 0 GPIO"
        range 0 48
        default 19 if IDF_TARGET_ESP32
        default 12 if IDF_TARGET_ESP32S3

    config MOL_GPIO_COLUMN1
        int "Matrix column 1 GPIO"
        range 0 48
        default 21 if IDF_TARGET_ESP32
        default 13 if IDF_TARGET_ESP32S3

    config MOL_GPIO_COLUMN2
        int "Matrix column 2 GPIO"
        range 0 48
        default 23 if IDF_TARGET_ESP32
        default 14 if IDF_TARGET_ESP32S3

    config MOL_GPIO_COLUMN3
        int "Matrix column 3 GPIO"
        range 0 48
        default 27 if IDF_TARGET_ESP32
        default 15 if IDF_TARGET_ESP32S3

    config MOL_GPIO_COLUMN4
        int "Matrix column 4 GPIO"
        range 0 48
        default 32 if IDF_TARGET_ESP32
        default 16 if IDF_TARGET_ESP32S3

    config MOL_GPIO_COLUMN5
        int "Matrix column 5 GPIO"
        range 0 48
        default 33 if IDF_TARGET_ESP32
        default 17 if IDF_TARGET_ESP32S3

    config MOL_GPIO_SCAN_PERIOD_MS
        int "Matrix scan period in milliseconds"
        range 1 5
        default 1

    config MOL_GPIO_SETTLE_US
        int "Row settle time in microseconds"
        range 1 50
        default 3

    config MOL_GPIO_DEBOUNCE_MS
        int "Matrix debounce time in milliseconds"
        range 5 20
        default 8

    choice MOL_GPIO_GHOST_POLICY
        prompt "Matrix ghosting policy"
        default MOL_GPIO_GHOST_SUPPRESS

        config MOL_GPIO_GHOST_SUPPRESS
            bool "Suppress ambiguous rectangles (no diodes)"

        config MOL_GPIO_GHOST_ALLOW
            bool "Allow all scanned keys (diode matrix)"
    endchoice

    config MOL_GPIO_VELOCITY_PERCENT
        int "Fixed key velocity in percent"
        range 1 100
        default 80

    config MOL_GPIO_CONFIG_KEY
        int "Key index used to enter configuration mode"
        range 0 29
        default 29

    config MOL_GPIO_CONFIG_HOLD_MS
        int "Configuration-key hold time in milliseconds"
        range 1000 10000
        default 3000

    config MOL_GPIO_CLEAR_PAIRING_KEY
        int "Key paired with the configuration key to clear Bluetooth bonds"
        range 0 29
        default 28

    config MOL_GPIO_CLEAR_PAIRING_HOLD_MS
        int "Clear-pairing chord hold time in milliseconds"
        range 3000 15000
        default 5000

    config MOL_GPIO_FACTORY_RESET_KEY
        int "Key paired with the configuration key to restore factory defaults"
        range 0 29
        default 27

    config MOL_GPIO_FACTORY_RESET_HOLD_MS
        int "Factory-reset chord hold time in milliseconds"
        range 5000 20000
        default 8000

    config MOL_GPIO_TASK_PRIORITY
        int "GPIO scan task priority"
        range 1 19
        default 12

    config MOL_GPIO_TASK_CORE
        int "GPIO scan task core affinity"
        range 0 1
        default 0

    config MOL_GPIO_TASK_STACK_SIZE
        int "Static GPIO scan task stack size in bytes"
        range 2048 8192
        default 3072

    endif

endmenu
```

## platforms/esp32/sdkconfig.defaults
```kconfig
# SPDX-License-Identifier: Apache-2.0
CONFIG_COMPILER_OPTIMIZATION_SIZE=y
CONFIG_COMPILER_OPTIMIZATION_ASSERTIONS_SILENT=y
CONFIG_ESP_MAIN_TASK_STACK_SIZE=4096
CONFIG_FREERTOS_HZ=1000
CONFIG_FREERTOS_SUPPORT_STATIC_ALLOCATION=y
CONFIG_ESP_TASK_WDT_EN=y
CONFIG_ESP_TASK_WDT_INIT=y
CONFIG_ESP_SYSTEM_PANIC_PRINT_REBOOT=y
CONFIG_PARTITION_TABLE_CUSTOM=y
CONFIG_PARTITION_TABLE_CUSTOM_FILENAME="partitions.csv"
CONFIG_FATFS_LFN_HEAP=y
CONFIG_FATFS_MAX_LFN=64
```

## platforms/esp32/sdkconfig.defaults.esp32
```kconfig
# SPDX-License-Identifier: Apache-2.0
CONFIG_BTDM_CTRL_MODE_BTDM=y
CONFIG_BTDM_CTRL_BLE_MAX_CONN=1
CONFIG_BT_ACL_CONNECTIONS=2
CONFIG_BT_CLASSIC_ENABLED=y
CONFIG_BT_HID_ENABLED=y
CONFIG_BT_HID_HOST_ENABLED=y
```

## platforms/esp32/sdkconfig.defaults.esp32s3
```kconfig
# SPDX-License-Identifier: Apache-2.0
CONFIG_BT_BLE_42_FEATURES_SUPPORTED=y
CONFIG_BT_ACL_CONNECTIONS=1
```

## platforms/esp32/sdkconfig.defaults.web
```kconfig
# SPDX-License-Identifier: Apache-2.0
CONFIG_MOL_DEVICE_WEB_UI_ENABLE=y
CONFIG_ESPTOOLPY_FLASHSIZE_4MB=y
CONFIG_PARTITION_TABLE_CUSTOM_FILENAME="partitions-web.csv"
```
